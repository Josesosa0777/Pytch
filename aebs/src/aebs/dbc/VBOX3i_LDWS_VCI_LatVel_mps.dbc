VERSION ""

NS_ :

BS_:

BU_:

BO_ 778 VBOX_LDWS_VCI_1: 8 Vector__XXX
 SG_ Range_Lt : 7|32@0- (1,0) [0|0] "Metres" Vector__XXX
 SG_ Range_Rt : 39|32@0- (1,0) [0|0] "Meters" Vector__XXX

BO_ 779 VBOX_LDWS_VCI_2: 8 Vector__XXX
 SG_ Lat_Spd_Lt : 7|32@0- (0.36,0) [0|0] "m/s" Vector__XXX
 SG_ Status : 39|32@0- (1,0) [0|0] "" Vector__XXX

BO_ 780 VBOX_LDWS_VCI_3: 8 Vector__XXX
 SG_ TTLC_Lt : 7|32@0- (1,0) [0|0] "Seconds" Vector__XXX
 SG_ Lat_Spd_Rt : 39|32@0- (0.36,0) [0|0] "m/s" Vector__XXX

BO_ 781 VBOX_LDWS_VCI_4: 8 Vector__XXX
 SG_ TTLC_Rt : 7|32@0- (1,0) [0|0] "Seconds" Vector__XXX
 SG_ Angle : 39|32@0- (1,0) [0|0] "Deg" Vector__XXX

BA_DEF_  "BusType" STRING ;
BA_DEF_DEF_  "BusType" "CAN";
SIG_VALTYPE_ 778 Range_Lt : 1;
SIG_VALTYPE_ 778 Range_Rt : 1;
SIG_VALTYPE_ 779 Lat_Spd_Lt : 1;
SIG_VALTYPE_ 779 Status : 1;
SIG_VALTYPE_ 780 TTLC_Lt : 1;
SIG_VALTYPE_ 780 Lat_Spd_Rt : 1;
SIG_VALTYPE_ 781 TTLC_Rt : 1;
SIG_VALTYPE_ 781 Angle : 1;
